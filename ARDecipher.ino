#include <Arduboy2.h>
#include "src/fonts/Font4x6.h"

#define STATE_TITLE 0
#define STATE_PLAY 1
#define STATE_WIN 2
#define STATE_LOSE 3
#define STATE_HELP 4

#define WORD_SPAN_X 48
#define WORD_SPAN_Y 12
#define WORD_BASE_X 4
#define WORD_BASE_Y 4

#define WORD_NUM_X 2
#define WORD_NUM_Y 5
#define WORD_NUM (WORD_NUM_X * WORD_NUM_Y)
#define WORD_SIZE 6
#define WORDS_SIZE (WORD_NUM * WORD_SIZE)

#define HAND_BASE_X 36
#define HAND_BASE_Y 6

#define MAX_RETRY_NUM 5

#define INIT_HIT_NUM 0xff

typedef uint8_t u8;

const u8 PROGMEM bmpTitle[] = {
    110, 43,
    0x00, 0x00, 0x00, 0x00, 0x00, 0x00, 0x80, 0xe0, 
    0xfc, 0xfc, 0xfc, 0xe0, 0x00, 0x00, 0x00, 0x00, 
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    0x00, 0x00, 0x00, 0x00,
};

const u8 PROGMEM bmpProhibition[] = {
    50, 50,
    0x00, 0x00, 0x00, 0x00, 0x00, 0x00, 0x00, 0x00, 
    0x80, 0xc0, 0xc0, 0xe0, 0xf0, 0x70, 0x78, 0x38, 
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    0x00, 0x00, 0x00, 0x00, 0x00, 0x00,
};

const u8 PROGMEM bmpTrophy[] = {
    50, 50,
    0x00, 0x00, 0x00, 0x00, 0x00, 0x00, 0xff, 0xff, 
    0x03, 0x07, 0x0f, 0x1f, 0x18, 0x38, 0xfc, 0xfc, 
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    0x00, 0x00, 0x00, 0x00, 0x00, 0x00,
};

const u8 PROGMEM bmpHand[] = {
    6, 4,
    0x02, 0x06, 0x0f, 0x0b, 0x0b, 0x0e, 
};

const u8 PROGMEM bmpShield[] = {
    16, 16,
    0x00, 0x00, 0x00, 0xcc, 0x04, 0x04, 0x04, 0x02,
    0xfe, 0xfc, 0xfc, 0xfc, 0xfc, 0xf8, 0x00, 0x00,
    0x00, 0x00, 0x00, 0x07, 0x18, 0x20, 0x40, 0xc0,
    0xff, 0x7f, 0x3f, 0x1f, 0x0f, 0x01, 0x00, 0x00,
};

int gameState = STATE_TITLE;

u8 wordBuff[WORDS_SIZE];
u8 password[WORD_SIZE];

u8 pickX = 0;
u8 pickY = 0;

u8 retryNum = 0;

u8 hitNum[WORD_NUM] = {0};

Arduboy2 arduboy;
Font4x6 font4x6 = Font4x6();

void setup() { 
    arduboy.boot();
    arduboy.setFrameRate(45);
    arduboy.display();
    arduboy.initRandomSeed();
    arduboy.clear();
}

void loop() {
    if (!arduboy.nextFrame()) {
        return;
    }
    arduboy.pollButtons();
    arduboy.clear();
    gameLoop();
    arduboy.display();
}

void titleScreen() {
    arduboy.drawBitmap(9, 10, bmpTitle + 2, bmpTitle[0], bmpTitle[1], WHITE);
    font4x6.setCursor(85, 38);
    font4x6.print(F("A Start\nB Help"));

    if (arduboy.justPressed(A_BUTTON)) {
        resetGame();
        gameState = STATE_PLAY;
    }
    if (arduboy.justPressed(B_BUTTON)) {
        gameState = STATE_HELP;
    }
}

void winScreen() {
    arduboy.drawBitmap(20, 7, bmpTrophy + 2, bmpTrophy[0], bmpTrophy[1], WHITE);
    arduboy.setCursor(84, 30);
    arduboy.print(F("Pass"));

    if (arduboy.justPressed(A_BUTTON)) {
        gameState = STATE_TITLE;
    }
}

void loseScreen() {
    arduboy.drawBitmap(20, 7, bmpProhibition + 2, bmpProhibition[0], bmpProhibition[1], WHITE);
    arduboy.setCursor(84, 30);
    arduboy.print(F("Fail"));

    if (arduboy.justPressed(A_BUTTON)) {
        gameState = STATE_TITLE;
    }
}

void helpScreen() {
    font4x6.setCursor(7, 10);
    font4x6.print(F("Similar to the terminal\nhack in Fallout 4."));
    font4x6.print(F("You\ncan only try "));
    font4x6.print(MAX_RETRY_NUM);
    font4x6.print(F(" times."));
    font4x6.print(F("\n\n   press A to return"));

    if (arduboy.justPressed(A_BUTTON)) {
        gameState = STATE_TITLE;
    }
}

void resetGame() {
    genWordList();
    pickX = 0;
    pickY = 0;
    retryNum = 0;
    memset(hitNum, INIT_HIT_NUM, WORD_NUM);
}

u8 calcHit(u8* word) {
    u8 hitCount = 0;
    for (int i = 0; i < WORD_SIZE; i++) {
        if (password[i] == *(word + i)) {
            hitCount += 1;
        }
    }
    return hitCount;
}

void genWord(u8* buff) {
    for (int i = 0; i < WORD_SIZE; i++) {
        u8 symbol = 65 + random(26);
        *(buff + i) = symbol;
    }
}

void genWordList() {
    u8 decoyWord1[WORD_SIZE];
    u8 decoyWord2[WORD_SIZE];
    
    randomSeed(millis());
    genWord(password);
    genWord(decoyWord1);
    genWord(decoyWord2);

    for (int i = 0; i < WORDS_SIZE; i++) {
        u8 symbol = password[i % WORD_SIZE];
        u8 chance = random(WORD_SIZE);
        if ((chance >= 2) && (chance <= 4)) {
            symbol = decoyWord1[i % WORD_SIZE];
        } else if ((chance >= 5) && (chance <= 6)) {
            symbol = decoyWord2[i % WORD_SIZE];
        }
        wordBuff[i] = symbol;
    }

    u8 passwordOffset = random(WORD_NUM) * WORD_SIZE;
    memcpy(wordBuff + passwordOffset, password, WORD_SIZE);
}

void playScreen() {
    // Print words
    char word[WORD_SIZE + 1];
    word[WORD_SIZE] = 0x00;
    for (int ix = 0; ix < WORD_NUM_X; ix++) {
        for (int iy = 0; iy < WORD_NUM_Y; iy++) {
            int x = WORD_BASE_X + ix * WORD_SPAN_X;
            int y = WORD_BASE_Y + iy * WORD_SPAN_Y;
            int offset = WORD_SIZE * (ix * WORD_NUM_Y + iy);
            memcpy(word, wordBuff + offset, WORD_SIZE);
            font4x6.setCursor(x, y);
            font4x6.print(word);
        }
    }

    // Draw hand pointer
    u8 handX = HAND_BASE_X + pickX * WORD_SPAN_X;
    u8 handY = HAND_BASE_Y + pickY * WORD_SPAN_Y;
    arduboy.drawBitmap(handX, handY, bmpHand + 2, bmpHand[0], bmpHand[1], WHITE);

    // Draw stats
    arduboy.drawBitmap(102, 4, bmpShield + 2, bmpShield[0], bmpShield[1], WHITE);

    font4x6.setCursor(100, 22);
    font4x6.print(F("retry"));
    font4x6.setCursor(108, 32);
    font4x6.print(retryNum);

    font4x6.setCursor(104, 42);
    font4x6.print(F("hit"));
    u8 wordIndex = pickX * WORD_NUM_Y + pickY;
    if (hitNum[wordIndex] == INIT_HIT_NUM) {
        arduboy.setCursor(108, 52);
        arduboy.print(F("-"));
    } else {
        font4x6.setCursor(108, 52);
        font4x6.print(hitNum[wordIndex]);
    }
    
    // Button events
    if (arduboy.justPressed(A_BUTTON)) {
        if (hitNum[wordIndex] != INIT_HIT_NUM) {
            // Skipped
        } else if (retryNum < MAX_RETRY_NUM) {
            retryNum += 1;
            u8 wordOffset = WORD_SIZE * (pickX * WORD_NUM_Y + pickY);
            hitNum[wordIndex] = calcHit(wordBuff + wordOffset);
            if (hitNum[wordIndex] == WORD_SIZE) {
                gameState = STATE_WIN;
                return;
            }
            if (retryNum >= MAX_RETRY_NUM) {
                gameState = STATE_LOSE;
                return;
            }
        }
    }
    if (arduboy.justPressed(UP_BUTTON)) {
        if (pickY > 0) {
            pickY -= 1;
        }
    }
    if (arduboy.justPressed(DOWN_BUTTON)) {
        if (pickY < WORD_NUM_Y - 1) {
            pickY += 1;
        }
    }
    if (arduboy.justPressed(LEFT_BUTTON)) {
        if (pickX > 0) {
            pickX -= 1;
        }
    }
    if (arduboy.justPressed(RIGHT_BUTTON)) {
        if (pickX < WORD_NUM_X - 1) {
            pickX += 1;
        }
    }
}

void gameLoop() {
    switch (gameState) {
        case STATE_TITLE:
            titleScreen();
            break;
        case STATE_PLAY:
            playScreen();
            break;
        case STATE_WIN:
            winScreen();
            break;
        case STATE_LOSE:
            loseScreen();
            break;
        case STATE_HELP:
            helpScreen();
            break;
        default:
            break;
    }
}

